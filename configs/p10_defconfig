## configs/p10_defconfig
```kconfig
BR2_powerpc64le=y
BR2_powerpc_power8=y
BR2_ROOTFS_POST_IMAGE_SCRIPT="$(TOPDIR)/mkcraff.sh"
BR2_LINUX_KERNEL=y
BR2_LINUX_KERNEL_CUSTOM_GIT=y
BR2_LINUX_KERNEL_CUSTOM_REPO_URL="ssh://git@github.ibm.com/p10/linux.git"
BR2_LINUX_KERNEL_CUSTOM_REPO_VERSION="fd67c6c03c80"
BR2_LINUX_KERNEL_USE_ARCH_DEFAULT_CONFIG=y
BR2_LINUX_KERNEL_VMLINUX=y
BR2_TARGET_ROOTFS_CPIO=y
# BR2_TARGET_ROOTFS_TAR is not set
```
